## config/dts/bindings/input_processors/zmk,input-processor-temp-layer-threshold.yaml
```yaml
# Copyright (c) 2024 ZMK Contributors
# SPDX-License-Identifier: MIT

description: |
  Threshold-based temporary layer input processor for ZMK.
  Activates a layer only when accumulated mouse movement exceeds the threshold.

compatible: "zmk,input-processor-temp-layer-threshold"

properties:
  "#input-processor-cells":
    type: int
    required: true
    const: 2

  threshold:
    type: int
    default: 5
    description: |
      Movement threshold in pixels. The layer will only activate
      when the cumulative absolute movement exceeds this value.

  threshold-time-ms:
    type: int
    default: 100
    description: |
      Time window in milliseconds for accumulating movement.

  require-prior-idle-ms:
    type: int
    default: 0
    description: |
      Time in milliseconds that must pass after the last keystroke
      before the layer can be toggled.

  excluded-positions:
    type: array
    default: []
    description: |
      Array of key positions that will NOT trigger layer deactivation.

input-processor-cells:
  - param1
  - param2
```

## modules/zmk-input-processor-temp-layer-threshold/Kconfig
```kconfig
config ZMK_INPUT_PROCESSOR_TEMP_LAYER_THRESHOLD
    bool "Enable threshold-based temporary layer input processor"
    default y
    depends on ZMK_KEYMAP
    help
      Enable input processor that activates a temporary layer only when
      the accumulated mouse movement exceeds a configurable threshold.
```

## modules/zmk-input-processor-temp-layer-threshold/dts/bindings/zmk,input-processor-temp-layer-threshold.yaml
```yaml
description: |
  Threshold-based temporary layer input processor for ZMK.
  Activates a layer only when accumulated mouse movement exceeds the threshold.

  Parameters:
    param1: Layer number to activate
    param2: Timeout in milliseconds

compatible: "zmk,input-processor-temp-layer-threshold"

include: base.yaml

properties:
  "#input-processor-cells":
    type: int
    required: true
    const: 2
    description: |
      Number of cells required: layer number and timeout (ms).

  threshold:
    type: int
    default: 5
    description: |
      Movement threshold in pixels. The layer will only activate
      when the cumulative absolute movement exceeds this value.
      Higher values require more movement before layer activation.

  threshold-time-ms:
    type: int
    default: 100
    description: |
      Time window in milliseconds for accumulating movement.
      Movement is accumulated within this window to check against threshold.

  require-prior-idle-ms:
    type: int
    default: 0
    description: |
      If set to a non-zero value, the layer will only activate if
      there have been no key presses for at least this many milliseconds.

  excluded-positions:
    type: array
    default: []
    description: |
      Key positions that will not deactivate the temporary layer when pressed.
```
